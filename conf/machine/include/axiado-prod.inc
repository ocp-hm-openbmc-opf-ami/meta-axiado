## conf/machine/include/axiado-prod.inc
```bitbake
# Copyright (c) 2021-24 Axiado Corporation (or its affiliates). All rights reserved.
# Use, modification and redistribution of this file is subject to your possession
# of a valid End User License Agreement (EULA) for the Axiado Product of which
# these sources are part of and your compliance with all applicable terms and
# conditions of such licence agreement.

WKS_FILE ?= "emmc-axiado.wks.in"
WKS_FILE_DEPENDS ?= "virtual/kernel"
WKS_FILE_DEPENDS += "e2fsprogs-native"

IMAGE_BOOT_FILES ?= "fitImage"

require conf/distro/include/phosphor-mmc.inc
```

## conf/machine/include/axiado.inc
```bitbake
# Copyright (c) 2021-24 Axiado Corporation (or its affiliates). All rights reserved.
# Use, modification and redistribution of this file is subject to your possession
# of a valid End User License Agreement (EULA) for the Axiado Product of which
# these sources are part of and your compliance with all applicable terms and
# conditions of such licence agreement.

SOC_FAMILY = "axiado-ax3000"
include conf/machine/include/soc-family.inc
include conf/machine/include/arm/arch-arm64.inc

PREFERRED_PROVIDER_virtual/kernel ?= "linux-axiado"
PREFERRED_PROVIDER_virtual/bootloader ?= "u-boot-axiado"
PREFERRED_PROVIDER_u-boot ?= "u-boot-axiado"

# Build var, valid values are dev and prod (production)
# Prod builds eMMC image with wic filesystem and kernel, dtb images
# Dev builds initramfs image with filesystem + kernel in a single image
# For modifying this value, add BUILD_VAR = "dev" in local.conf file under build/<machine>
BUILD_VAR ??= "prod"
AXIADO_INC_FILE := "${@bb.utils.contains('BUILD_VAR', 'dev', 'axiado-dev.inc', 'axiado-prod.inc', d)}"
INCLUDE_PATH := "conf/machine/include/"
require ${INCLUDE_PATH}${AXIADO_INC_FILE}

INITRAMFS_IMAGE_BUNDLE = "1"
IMAGE_CLASSES:append = " image_types_ax3000"

DEFAULTTUNE:ax3000 ?= "aarch64"

KERNEL_IMAGETYPE ?= "fitImage"
FLASH_KERNEL_IMAGE ?= "fitImage"

UBOOT_ENTRYPOINT ?= "0x3E000000"
UBOOT_LOADADDRESS ?= "0x3E000000"
UBOOT_DTB_LOADADDRESS ?= "0x3FF00000"

#this is needed by emmc, avoid removing it.
BAD_RECOMMENDATIONS:remove = "e2fsprogs-e2fsck"
```

## meta-evk/conf/layer.conf
```bitbake
LOCALCONF_VERSION = "4"
# We have a conf and classes directory, add to BBPATH
BBPATH .= ":${LAYERDIR}"

# We have recipes-* directories, add to BBFILES
BBFILES += "${LAYERDIR}/recipes-*/*/*.bb \
            ${LAYERDIR}/recipes-*/*/*.bbappend \
            ${LAYERDIR}/recipes-*/*/*/*.bb \
            ${LAYERDIR}/recipes-*/*/*/*.bbappend"

BBFILE_COLLECTIONS += "evk-axiado"
BBFILE_PATTERN_evk-axiado = "^${LAYERDIR}/"
BBFILE_PRIORITY_evk-axiado = "11"
LAYERSERIES_COMPAT_evk-axiado = "nanbield scarthgap"
MULTI_SOL_ENABLED = "1"
IMAGE_INSTALL:append = " srvcfg-manager"
ENABLE_BONDING = "network-bond"

BBMASK += '${@bb.utils.contains("BBFILE_COLLECTIONS", "restricted", "/meta-core/meta-restricted/recipes-intel/images/intel-platforms.bbappend", "",d)}'
EXTRA_IMAGE_FEATURES:remove = '${@bb.utils.contains("BBFILE_COLLECTIONS", "restricted", "    acd-features \
    mrt-features \
    nm-features \
    oob-config-features \
    ras-offload-features \
    seamless-features \
    telemetry-features \
    testability-features ", "",d)}'

IMAGE_INSTALL:append = " intel-ipmi-oem webui-vue virtual-media phosphor-gpio-monitor "
IMAGE_INSTALL:append = '${@bb.utils.contains("EXTRA_IMAGE_FEATURES", "use-lfmctp", "", " pmci-launcher nvmemi-daemon pldmd mctpd ",d)}'

IMAGE_INSTALL:remove = " mac-hostname"
```

## meta-evk/conf/machine/evk-axiado.conf
```bitbake
UBOOT_MACHINE ??= "ax3000_evk_defconfig"

require conf/machine/include/axiado.inc
require conf/machine/include/obmc-bsp-common.inc

SERIAL_CONSOLES = "115200;ttyPS3"

INITRAMFS_MAXSIZE = "631072"
OBMC_COMPATIBLE_NAMES = "ax3000"
EXTENDED_VERSION = "${DISTRO_VERSION}"

# Install Kernel modules
MACHINE_EXTRA_RRECOMMENDS = "kernel-modules"

MACHINE_FEATURES += "\
		     obmc-host-ipmi \
		     obmc-phosphor-fan-mgmt \
		     obmc-phosphor-chassis-mgmt \
		     obmc-phosphor-flash-mgmt \
		     obmc-host-state-mgmt \
		     obmc-chassis-state-mgmt \
		     obmc-bmc-state-mgmt \
		    "
PREFERRED_PROVIDER_virtual/kernel = "linux-aspeed"
PREFERRED_PROVIDER_virtual/obmc-host-ipmi-hw = "${@bb.utils.contains('IPMI_BT_SUPPORT', 'ipmi-bt-enable', 'phosphor-ipmi-bt', 'phosphor-ipmi-kcs', d)}"
PREFERRED_PROVIDER_virtual/obmc-chassis-mgmt = "packagegroup-axiado-apps"
PREFERRED_PROVIDER_virtual/obmc-fan-mgmt = "packagegroup-axiado-apps"
PREFERRED_PROVIDER_virtual/obmc-flash-mgmt = "packagegroup-axiado-apps"
PREFERRED_PROVIDER_virtual/obmc-system-mgmt = "packagegroup-axiado-apps"
VIRTUAL-RUNTIME_obmc-host-state-manager = "x86-power-control"
VIRTUAL-RUNTIME_obmc-chassis-state-manager = "x86-power-control"
VIRTUAL-RUNTIME_obmc-discover-system-state = "x86-power-control"
```
